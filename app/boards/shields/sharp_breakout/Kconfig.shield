## app/boards/shields/sharp_breakout/Kconfig.shield
```kconfig
# Copyright (c) 2025 Nordic Semiconductor ASA
# SPDX-License-Identifier: Apache-2.0

config SHIELD_SHARP_DISPLAY
	def_bool $(shields_list_contains,sharp_display)
```

## drivers/display/Kconfig
```kconfig
# Copyright (c) 2024 Nordic Semiconductor ASA
# SPDX-License-Identifier: Apache-2.0

if DISPLAY
rsource "sharp_ls0xxb7_bitbang/Kconfig"
endif # DISPLAY
```

## drivers/display/sharp_ls0xxb7_bitbang/Kconfig
```kconfig
# Copyright (c) 2021 Nordic Semiconductor ASA
# SPDX-License-Identifier: Apache-2.0

config SHARP_LS0XXB7_BITBANG
	bool "SHARP LS0XXB7 Bitbang driver"
	default y
	# depends on DT_HAS_ZEPHYR_SHARP_LS0XXB7_BITBANG_ENABLED
	# select DISPLAY
	help
	  Sharp LS0XXB7 Bitbang driver

menu "Sharp LS0XXB7 Display Options"

choice
    prompt "Display Mode"
    default SHARP_LS0XXB7_DISPLAY_MODE_COLOR

config SHARP_LS0XXB7_DISPLAY_MODE_COLOR
    bool "Color (6-bit, 2-bit per R/G/B). Currently internally represented as a 16-bit RGB565 value in the internal buffer to enable use with LGVL."

config SHARP_LS0XXB7_DISPLAY_MODE_RGB2222
    bool "Uses a (8-bit) pixel format, normally used for grayscale, but internally interprets it as an RGB2222 value."

config SHARP_LS0XXB7_DISPLAY_MODE_MONOCHROME
    bool "Monochrome (1-bit). If black/white is all you need, this mode saves RAM by keeping only one bit per pixel in the buffer."

endchoice

endmenu
```
